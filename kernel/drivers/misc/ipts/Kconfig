## kernel/drivers/misc/ipts/Kconfig
```kconfig
config INTEL_IPTS
	tristate "Intel Precise Touch & Stylus"
	select INTEL_MEI
	depends on X86 && PCI && HID
	help
	  Intel Precise Touch & Stylus support
	  Supported SoCs:
	  Intel Skylake
	  Intel Kabylake
```
